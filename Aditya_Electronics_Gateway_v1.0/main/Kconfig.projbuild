## Aditya_Electronics_Gateway_v1.0/main/Kconfig.projbuild
```kconfig
menu "Aditya IoT Gateway Configuration"

    config FW_VERSION
        string "Firmware version string"
        default "2.0-Beta"
        help
            Firmware version reported at boot (console log) and
            available to the rest of the app as CONFIG_FW_VERSION.
            Change via "idf.py menuconfig" -> "Aditya IoT Gateway
            Configuration" -> "Firmware version string", or edit the
            default above and rebuild.

endmenu
```
